## drivers/staging/apple-bce/Kconfig
```kconfig
config APPLE_BCE
	tristate "Apple BCE driver (VHCI and Audio support)"
	default m
	depends on X86
	select SOUND
	select SND
	select SND_PCM
	select SND_JACK
	help
	  VHCI and audio support on Apple MacBooks with the T2 Chip.
	  This driver is divided in three components:
	    - BCE (Buffer Copy Engine): which establishes a basic communication
	      channel with the T2 chip. This component is required by the other two:
	      - VHCI (Virtual Host Controller Interface): Access to keyboard, mouse
	        and other system devices depend on this virtual USB host controller
	      - Audio: a driver for the T2 audio interface.
	 
	  If "M" is selected, the module will be called apple-bce.'
```

## drivers/staging/t2bce/Kconfig
```kconfig
# SPDX-License-Identifier: GPL-2.0-only
menu "Apple T2 Buffer Copy Engine support"

config T2BCE_DMA
	tristate
	help
	  DMA queue support for the Apple T2 Buffer Copy Engine.

config T2BCE_CORE
	tristate "Apple T2 Buffer Copy Engine core"
	depends on X86_64 && PCI
	select T2BCE_DMA
	help
	  Core transport driver for the Buffer Copy Engine in Apple T2 Macs.
	  It provides the mailbox, DMA queue coordination, power management,
	  and transport API used by the T2 VHCI and audio drivers.

	  If compiled as a module, it will be called t2bce_core.

config T2BCE_VHCI
	tristate "Apple T2 virtual USB host controller"
	depends on T2BCE_CORE && USB
	help
	  Virtual USB 2.0 host controller for devices exposed by bridgeOS,
	  including the internal keyboard, trackpad, Touch Bar, and camera.

	  If compiled as a module, it will be called t2bce_vhci.

config T2BCE_AUDIO
	tristate "Apple T2 audio support"
	depends on T2BCE_CORE && SND
	select SND_PCM
	select SND_JACK
	help
	  ALSA driver for the audio endpoints exposed by bridgeOS on Apple
	  T2 Macs.

	  If compiled as a module, it will be called t2bce_audio.

endmenu
```

## kernel/Kconfig.hz
```kconfig
# SPDX-License-Identifier: GPL-2.0-only
#
# Timer Interrupt Frequency Configuration

choice
	prompt "Timer Frequency"
	default HZ_250
	help
	 Select the desired timer frequency. The timer interrupt frequency determines
	 how often the system generates interrupts to handle time-related tasks.
	 Different frequencies offer trade-offs between interactive responsiveness,
	 system stability, power consumption, and overall system performance.

	config HZ_100
		bool "100 Hz"
	help
	  Select 100 Hz for servers, symmetric multiprocessing (SMP), and non-uniform
	  memory access (NUMA) systems with multiple processors. This choice reduces
	  interrupt overhead and enhances overall system stability. It is particularly
	  suitable for scenarios where quick user interaction is not crucial, such as
	  servers handling heavy workloads without immediate user feedback. It provides
	  a balanced performance level for background tasks and workloads that do not
	  require real-time responsiveness.

	config HZ_250
		bool "250 Hz"
	help
	 Select 250 Hz as a balanced option suitable for a wide range of scenarios.
	 It provides a compromise between interrupt frequency, server performance,
	 and interactive responsiveness. This choice ensures smooth execution of
	 server workloads while maintaining satisfactory interactive response times.
	 It is suitable for general-purpose computing scenarios where a balance
	 between system performance and interactivity is required. Examples include
	 web servers, database servers, and cloud infrastructure.

	config HZ_300
		bool "300 Hz"
	help
	 Select 300 Hz to strike a balance between server performance and interactive
	 responsiveness. This choice works well on SMP and NUMA systems and offers
	 improved interactivity compared to lower frequencies. It is suitable for
	 various workloads, including multimedia applications that require smoother
	 interactive experiences. Examples include media streaming servers or video
	 conferencing platforms.

	config HZ_500
		bool "500 Hz"
	help
	 Select 500 Hz for a balanced timer frequency that prioritizes both responsiveness
	 and energy efficiency. It provides fast interactivity on desktop systems without
	 significantly increasing power consumption or sacrificing battery life on laptops.
	 This choice is suitable for general-purpose computing scenarios where quick
	 user feedback is desirable. Examples include personal computers or laptops used
	 for web browsing, document editing, and general multitasking.

	config HZ_600
		bool "600 Hz"
	help
	 Select 600 Hz for a balanced timer frequency that maintains fast interactivity
	 on desktop systems. It offers a slight boost in responsiveness compared to lower
	 frequencies without substantially increasing power consumption or sacrificing
	 battery life on laptops. This choice is suitable for a wide range of computing
	 tasks, including interactive applications and multitasking scenarios. Examples
	 include gaming systems, graphical design workstations, or software development
	 environments.

	config HZ_750
		bool "750 Hz"
	help
	 Select 750 Hz for a balanced timer frequency that ensures fast interactivity
	 on desktop systems. It provides improved responsiveness compared to lower
	 frequencies without substantially increasing power consumption or sacrificing
	 battery life on laptops. This choice is suitable for interactive workloads
	 and applications that require quick user feedback, such as gaming or real-time
	 simulations. Examples include real-time strategy games or virtual reality
	 applications.

	config HZ_833
		bool "833 Hz"
	help
	 Select 833 Hz as an alternative to 1000 Hz. This choice offers a balance between
	 latency and performance, providing a slightly lower interrupt frequency that
	 reduces interrupt overhead and improves system stability. It maintains satisfactory
	 interactive responsiveness and is suitable for various applications where a
	 lower interrupt frequency is desired without sacrificing overall system
	 performance. Examples include audio workstations or video editing systems that
	 require precise timing while minimizing system overhead.

	config HZ_1000
		bool "1000 Hz"
	help
	 Select 1000 Hz as the preferred choice for desktop systems and other scenarios
	 requiring rapid interactive responses. This high frequency ensures excellent
	 interactive responsiveness and is suitable for applications that require quick
	 user feedback and real-time interaction, such as graphical applications,
	 user interfaces, or latency-sensitive tasks. Examples include graphical design
	 workstations, real-time monitoring systems, or gaming platforms. However, it
	 may result in increased interrupt overhead and slightly higher power consumption.

	config HZ_1666
		bool "1666 Hz"
	help
	 Select 1666 Hz for systems with low latency requirements. This choice prioritizes
	 low latency over overall throughput and performance. It offers a snappier feel
	 in response to interactive processes and is suitable for real-time systems,
	 latency-sensitive workloads, and applications that demand quick response times,
	 such as real-time audio or video processing. Examples include audio production
	 systems, video streaming platforms, or real-time control systems. However, it
	 may result in increased power consumption and slightly reduced overall system
	 throughput.

	config HZ_2000
		bool "2000 Hz"
	help
	 Select 2000 Hz for demanding scenarios that require extremely fast timer interrupt
	 responses. This choice offers exceptional interactive responsiveness and is ideal
	 for ultra-low latency and real-time applications where precise timing is crucial,
	 such as high-frequency trading or control systems. Examples include financial
	 trading platforms or robotics control systems. However, it significantly increases
	 interrupt overhead, power consumption, system load, and may negatively impact overall
	 system stability.

	config HZ_5000
		bool "5000 Hz"
	help
	 Select 5000 Hz for specialized systems with stringent real-time requirements.
	 This choice provides ultra-fast and precise timer interrupt responses, making it
	 suitable for time-critical applications that require sub-millisecond accuracy,
	 such as scientific simulations or robotics control. Examples include real-time
	 simulations, scientific research platforms, or industrial automation systems.
	 However, it significantly increases interrupt overhead, power consumption, system load,
	 and may negatively impact overall system stability.

	config HZ_10000
		bool "10000 Hz"
	help
	 Select 10000 Hz for extremely high-frequency scenarios that demand ultra-fast and
	 precise timer interrupt responses. This choice offers exceptional responsiveness
	 and sub-microsecond accuracy, making it ideal for critical real-time applications,
	 such as aerospace systems or medical equipment control. Examples include avionics
	 systems, medical imaging platforms, or high-performance scientific computing.
	 However, it significantly increases interrupt overhead, power consumption, system load,
	 and may negatively affect overall system stability. Use with caution.

endchoice

config HZ
	int
	default 100 if HZ_100
	default 250 if HZ_250
	default 300 if HZ_300
	default 500 if HZ_500
	default 600 if HZ_600
	default 750 if HZ_750
	default 833 if HZ_833
	default 1000 if HZ_1000
	default 1666 if HZ_1666
	default 2000 if HZ_2000
	default 5000 if HZ_5000
	default 10000 if HZ_10000

config SCHED_HRTICK
	def_bool HIGH_RES_TIMERS
```
